/*
 * Right-side EC11 encoder — same pro_micro 20/21 pads as the left half.
 * Updates the sensors list so keymap binding index 1 maps to this encoder.
 */

/ {
    right_encoder: encoder_right {
        compatible = "alps,ec11";
        a-gpios = <&pro_micro 21 (GPIO_ACTIVE_HIGH | GPIO_PULL_UP)>;
        b-gpios = <&pro_micro 20 (GPIO_ACTIVE_HIGH | GPIO_PULL_UP)>;
        steps = <80>;
        status = "okay";
    };

    sensors {
        sensors = <&left_encoder &right_encoder>;
        triggers-per-rotation = <20>;
    };
};
